/*
 * Copyright (c) 2015, The Linux Foundation. All rights reserved.
 * Copyright (C) 2018 XiaoMi, Inc.
 *
 * This program is free software; you can redistribute it and/or modify
 * it under the terms of the GNU General Public License version 2 and
 * only version 2 as published by the Free Software Foundation.
 *
 * This program is distributed in the hope that it will be useful,
 * but WITHOUT ANY WARRANTY; without even the implied warranty of
 * MERCHANTABILITY or FITNESS FOR A PARTICULAR PURPOSE.  See the
 * GNU General Public License for more details.
 */

&int_codec {
	/delete-property/ qcom,cdc-us-euro-gpios;
	qcom,msm-mbhc-hphl-swh = <1>;
	qcom,msm-mbhc-gnd-swh = <1>;
		qcom,msm-mbhc-hphl-swh = <1>;
		qcom,msm-mbhc-gnd-swh = <1>;
		qcom,msm-hs-micbias-type = "external";
		qcom,msm-micbias1-ext-cap;
		qcom,msm-micbias2-ext-cap;
	qcom,smg3711-enable-gpio = <&tlmm 25 0>;
	qcom,smg3711-in-gpio = <&tlmm 16 0>;

	qcom,msm-gpios =
		"pri_i2s",
		"spk_ext_pa-sw";
	qcom,pinctrl-names =
		"all_off",
		"pri_i2s_act",
		"spk_ext_pa_act",
		"spk_ext_pa_sus";
	pinctrl-names =
		"all_off",
		"pri_i2s_act",
		"spk_ext_pa_act",
		"spk_ext_pa_sus";
	pinctrl-0 = <&cdc_pdm_lines_sus &cdc_pdm_lines_2_sus>;
	pinctrl-1 = <&cdc_pdm_lines_act &cdc_pdm_lines_2_act>;
	pinctrl-2 = <&spk_ext_pa_active>;
	pinctrl-3 = <&spk_ext_pa_suspend>;
	/delete-property/ pinctrl-4;
	/delete-property/ pinctrl-5;
	/delete-property/ pinctrl-6;
	/delete-property/ pinctrl-7;
        qcom,spk_ext_pa = <&tlmm 1 0>;
	qcom,audio-routing =
		"RX_BIAS", "MCLK",
		"SPK_RX_BIAS", "MCLK",
		"INT_LDO_H", "MCLK",
		"MIC BIAS External", "Handset Mic",
		"MIC BIAS External2", "Headset Mic",
		"MIC BIAS External", "Secondary Mic",
		"AMIC1", "MIC BIAS External",
		"AMIC2", "MIC BIAS External2",
		"AMIC3", "MIC BIAS External";

	asoc-codec = <&stub_codec>, <&pm8937_cajon_dig>, <&hdmi_dba>;
	asoc-codec-names = "msm-stub-codec.1", "cajon_codec",
			"msm-hdmi-dba-codec-rx";

};

&wsa881x_i2c_e {
	status = "disable";
};

&wsa881x_i2c_f {
	status = "disable";
};
